## drivers/cpufreq/Kconfig
```kconfig
config CPU_FREQ
	bool "CPU Frequency scaling"
	help
	  CPU Frequency scaling allows you to change the clock speed of 
	  CPUs on the fly. This is a nice method to save power, because 
	  the lower the CPU clock speed, the less power the CPU consumes.

	  Note that this driver doesn't automatically change the CPU
	  clock speed, you need to either enable a dynamic cpufreq governor
	  (see below) after boot, or use a userspace tool.

	  For details, take a look at <file:Documentation/cpu-freq>.

	  If in doubt, say N.

if CPU_FREQ

config CPU_FREQ_TABLE
	tristate

config CPU_FREQ_STAT
	tristate "CPU frequency translation statistics"
	select CPU_FREQ_TABLE
	default y
	help
	  This driver exports CPU frequency statistics information through sysfs
	  file system.

	  To compile this driver as a module, choose M here: the
	  module will be called cpufreq_stats.

	  If in doubt, say N.

config CPU_FREQ_STAT_DETAILS
	bool "CPU frequency translation statistics details"
	depends on CPU_FREQ_STAT
	help
	  This will show detail CPU frequency translation table in sysfs file
	  system.

	  If in doubt, say N.

choice
	prompt "Default CPUFreq governor"
	default CPU_FREQ_DEFAULT_GOV_USERSPACE if CPU_FREQ_SA1100 || CPU_FREQ_SA1110
	default CPU_FREQ_DEFAULT_GOV_PERFORMANCE
	help
	  This option sets which CPUFreq governor shall be loaded at
	  startup. If in doubt, select 'performance'.

config CPU_FREQ_DEFAULT_GOV_PERFORMANCE
	bool "performance"
	select CPU_FREQ_GOV_PERFORMANCE
	help
	  Use the CPUFreq governor 'performance' as default. This sets
	  the frequency statically to the highest frequency supported by
	  the CPU.


config CPU_FREQ_DEFAULT_GOV_POWERSAVE
	bool "powersave"
	depends on EXPERT
	select CPU_FREQ_GOV_POWERSAVE
	help
	  Use the CPUFreq governor 'powersave' as default. This sets
	  the frequency statically to the lowest frequency supported by
	  the CPU.

config CPU_FREQ_DEFAULT_GOV_USERSPACE
	bool "userspace"
	select CPU_FREQ_GOV_USERSPACE
	help
	  Use the CPUFreq governor 'userspace' as default. This allows
	  you to set the CPU frequency manually or when a userspace 
	  program shall be able to set the CPU dynamically without having
	  to enable the userspace governor manually.

config CPU_FREQ_DEFAULT_GOV_ONDEMAND
	bool "ondemand"
	select CPU_FREQ_GOV_ONDEMAND
	select CPU_FREQ_GOV_PERFORMANCE
	help
	  Use the CPUFreq governor 'ondemand' as default. This allows
	  you to get a full dynamic frequency capable system by simply
	  loading your cpufreq low-level hardware driver.
	  Be aware that not all cpufreq drivers support the ondemand
	  governor. If unsure have a look at the help section of the
	  driver. Fallback governor will be the performance governor.

config CPU_FREQ_DEFAULT_GOV_CONSERVATIVE
	bool "conservative"
	select CPU_FREQ_GOV_CONSERVATIVE
	select CPU_FREQ_GOV_PERFORMANCE
	help
	  Use the CPUFreq governor 'conservative' as default. This allows
	  you to get a full dynamic frequency capable system by simply
	  loading your cpufreq low-level hardware driver.
	  Be aware that not all cpufreq drivers support the conservative
	  governor. If unsure have a look at the help section of the
	  driver. Fallback governor will be the performance governor.


config CPU_FREQ_DEFAULT_GOV_SMARTASS2
	bool "smartass2"
	select CPU_FREQ_GOV_SMARTASS2
	help
		Use the CPUFreq governor 'smartassV2' as default.

config CPU_FREQ_DEFAULT_GOV_MAZWOZ
	bool "mazwoz"
	select CPU_FREQ_GOV_MAZWOZ
	help
		Use the CPUFreq governor 'mazwoz' as default.

config CPU_FREQ_DEFAULT_GOV_PEGASUSQ
	bool "pegasusq"
	select CPU_FREQ_GOV_PEGASUSQ
        help
        use as default governor

config CPU_FREQ_DEFAULT_GOV_SMARTASS2
	bool "smartass2"
	select CPU_FREQ_GOV_SMARTASS2
	help
		Use the CPUFreq governor 'smartassV2' as default.

config CPU_FREQ_DEFAULT_GOV_ASSWAX
	bool "asswax"
	select CPU_FREQ_GOV_ASSWAX
	help
	Use as default governor

config CPU_FREQ_DEFAULT_GOV_LIONHEART
	bool "lionheart"
	select CPU_FREQ_GOV_LIONHEART
	help
	Use as default governor

config CPU_FREQ_DEFAULT_GOV_HOTPLUG
	bool "hotplug"
	select CPU_FREQ_GOV_HOTPLUG
	help
	Use as default governor

config CPU_FREQ_DEFAULT_GOV_LAGFREE
        bool "lagfree"
        select CPU_FREQ_GOV_LAGFREE
        select CPU_FREQ_GOV_PERFORMANCE
        help
          Use the CPUFreq governor 'lagfree' as default. This allows
          you to get a full dynamic frequency capable system by simply
          loading your cpufreq low-level hardware driver.
          Be aware that not all cpufreq drivers support the lagfree
          governor. If unsure have a look at the help section of the
          driver. Fallback governor will be the performance governor

config CPU_FREQ_DEFAULT_GOV_WHEATLEY
	bool "wheatley"
	select CPU_FREQ_GOV_WHEATLEY
	help
	  Use the CPUFreq governor 'wheatley' as default.

config CPU_FREQ_DEFAULT_GOV_BADASS
 	bool "smoothass"
 	select CPU_FREQ_GOV_BADASS
 	select CPU_FREQ_GOV_PERFORMANCE
 	help
 	  Use the CPUFreq governor 'smoothass' as default.


config CPU_FREQ_DEFAULT_GOV_SAVAGEDZEN

	bool "smartass"
	select CPU_FREQ_GOV_SAVAGEDZEN
	select CPU_FREQ_GOV_PERFORMANCE
	help
	  Use the CPUFreq governor 'SavagedZen' as default.

config CPU_FREQ_DEFAULT_GOV_LULZACTIVE
	bool "lulzactive"
	select CPU_FREQ_GOV_LULZACTIVE
	select CPU_FREQ_GOV_PERFORMANCE
	help
	  Use the CPUFreq governor 'lulzactive' as default.

config CPU_FREQ_DEFAULT_GOV_SMARTASS
        bool "smartass"
        select CPU_FREQ_GOV_SMARTASS
        select CPU_FREQ_GOV_PERFORMANCE
        ---help---
          Use the CPUFreq governor 'smartass' as default.

config CPU_FREQ_DEFAULT_GOV_HYPER
        bool "HYPER"
        select CPU_FREQ_GOV_HYPER
        ---help---
          Use the CPUFreq governor 'HYPER' as default.

config CPU_FREQ_DEFAULT_GOV_ZENX
        bool "ZenX"
        select CPU_FREQ_GOV_ZENERACTIVE
        help
        Use the CPUFreq governor 'ZenX' as default.



endchoice

config CPU_FREQ_GOV_PERFORMANCE
	tristate "'performance' governor"
	help
	  This cpufreq governor sets the frequency statically to the
	  highest available CPU frequency.

	  To compile this driver as a module, choose M here: the
	  module will be called cpufreq_performance.

	  If in doubt, say Y.

config CPU_FREQ_GOV_POWERSAVE
	tristate "'powersave' governor"
	help
	  This cpufreq governor sets the frequency statically to the
	  lowest available CPU frequency.

	  To compile this driver as a module, choose M here: the
	  module will be called cpufreq_powersave.

	  If in doubt, say Y.

config CPU_FREQ_GOV_USERSPACE
	tristate "'userspace' governor for userspace frequency scaling"
	help
	  Enable this cpufreq governor when you either want to set the
	  CPU frequency manually or when a userspace program shall
	  be able to set the CPU dynamically, like on LART 
	  <http://www.lartmaker.nl/>.

	  To compile this driver as a module, choose M here: the
	  module will be called cpufreq_userspace.

	  For details, take a look at <file:Documentation/cpu-freq/>.

	  If in doubt, say Y.

config CPU_FREQ_GOV_ONDEMAND
	tristate "'ondemand' cpufreq policy governor"
	select CPU_FREQ_TABLE
	help
	  'ondemand' - This driver adds a dynamic cpufreq policy governor.
	  The governor does a periodic polling and 
	  changes frequency based on the CPU utilization.
	  The support for this governor depends on CPU capability to
	  do fast frequency switching (i.e, very low latency frequency
	  transitions). 

	  To compile this driver as a module, choose M here: the
	  module will be called cpufreq_ondemand.

	  For details, take a look at linux/Documentation/cpu-freq.

	  If in doubt, say N.



config CPU_FREQ_GOV_SMARTASS2
	tristate "'smartassV2' cpufreq governor"
	depends on CPU_FREQ
	help
		'smartassV2' - a "smart" governor
		If in doubt, say N.

config CPU_FREQ_GOV_MAZWOZ
	tristate "'mazwoz' cpufreq governor"
	depends on CPU_FREQ
	help
		'mazwoz' - a "smarter" governor based off of smartassv2
		If in doubt, say N.

config CPU_FREQ_GOV_CONSERVATIVE
	tristate "'conservative' cpufreq governor"
	depends on CPU_FREQ
	help
	  'conservative' - this driver is rather similar to the 'ondemand'
	  governor both in its source code and its purpose, the difference is
	  its optimisation for better suitability in a battery powered
	  environment.  The frequency is gracefully increased and decreased
	  rather than jumping to 100% when speed is required.

	  If you have a desktop machine then you should really be considering
	  the 'ondemand' governor instead, however if you are using a laptop,
	  PDA or even an AMD64 based computer (due to the unacceptable
	  step-by-step latency issues between the minimum and maximum frequency
	  transitions in the CPU) you will probably want to use this governor.

	  To compile this driver as a module, choose M here: the
	  module will be called cpufreq_conservative.

	  For details, take a look at linux/Documentation/cpu-freq.

	  If in doubt, say N.

config CPU_FREQ_GOV_ASSWAX
	tristate "'asswax' cpufreq governor"
	depends on CPU_FREQ
	help
	Use as default governors

config CPU_FREQ_GOV_LAZY
	tristate "'lazy' cpufreq governor"
	depends on CPU_FREQ

config CPU_FREQ_GOV_INTERACTIVEX
 tristate "'interactiveX' cpufreq policy governor"
  help
     'interactiveX' - Modified version of interactive with sleep+wake code.

config CPU_FREQ_GOV_LAGFREE
        tristate "'lagfree' cpufreq governor"
        depends on CPU_FREQ
        help
          'lagfree' - this driver is rather similar to the 'ondemand'
          governor both in its source code and its purpose, the difference is
          its optimisation for better suitability in a battery powered
          environment.  The frequency is gracefully increased and decreased
          rather than jumping to 100% when speed is required.

config LAGFREE_MAX_LOAD
	int "Max CPU Load"
	default 50
	depends on CPU_FREQ_GOV_LAGFREE
	help
	  CPU freq will be increased if measured load > max_cpu_load;

config LAGFREE_MIN_LOAD
	int "Min CPU Load"
	default 15
	depends on CPU_FREQ_GOV_LAGFREE
	help
	  CPU freq will be decrease if measured load < min_cpu_load;

config LAGFREE_FREQ_STEP_DOWN
	int "Frequency Step Down"
	default 108000
	depends on CPU_FREQ_GOV_LAGFREE
	help
	  Max freqeuncy delta when ramping down.

config LAGFREE_FREQ_SLEEP_MAX
	int "Max Sleep frequeny"
	default 384000
	depends on CPU_FREQ_GOV_LAGFREE
	help
	  Max freqeuncy for screen off.

config LAGFREE_FREQ_AWAKE_MIN
	int "Min Awake frequeny"
	default 384000
	depends on CPU_FREQ_GOV_LAGFREE
	help
	  Min freqeuncy for screen on.

config LAGFREE_FREQ_STEP_UP_SLEEP_PERCENT
	int "Freq step up percent sleep"
	default 20
	depends on CPU_FREQ_GOV_LAGFREE
	help
	  Frequency percent to step up while screen off.

config CPU_FREQ_MIN_TICKS
	int "Ticks between governor polling interval."
	default 10
	help
	  Minimum number of ticks between polling interval for governors.
 	

config CPU_FREQ_SAMPLING_LATENCY_MULTIPLIER
	int "Sampling rate multiplier for governors."
	default 1000
	help
	  Sampling latency rate multiplied by the cpu switch latency.
	  Affects governor polling.

config CPU_FREQ_GOV_WHEATLEY
	tristate "'wheatley' cpufreq governor"
	depends on CPU_FREQ
		help
	  'wheatley' - a performance based governor

config CPU_FREQ_GOV_LIONHEART
	tristate "'Lionheart' cpufreq governor"
	depends on CPU_FREQ
	help 
	   'Use Lionheart' .

config CPU_FREQ_GOV_BADASS
	tristate "'badass' cpufreq policy governor"
	select CPU_FREQ_TABLE
	help
	  'badass' - This driver adds a dynamic cpufreq policy governor.
	  The governor does a periodic polling and
	  changes frequency based on the CPU utilization.
	  The support for this governor depends on CPU capability to
	  do fast frequency switching (i.e, very low latency frequency
	  transitions).

	  To compile this driver as a module, choose M here: the
	  module will be called cpufreq_badass.

	  If in doubt, say N.

config CPU_FREQ_GOV_BADASS_2_PHASE
	tristate "'2-phase' power-efficiency badass algorithm"
	depends on CPU_FREQ_GOV_BADASS
	help
	  '2-phase' - This driver adds a new algo to save power

config CPU_FREQ_GOV_BADASS_2_PHASE_FREQ
	int "'2-phase' badass frequency"
	default 918000
	depends on CPU_FREQ_GOV_BADASS
	depends on CPU_FREQ_GOV_BADASS_2_PHASE

config CPU_FREQ_GOV_BADASS_3_PHASE
	tristate "'3-phase' power-efficiency badass algorithm"
	depends on CPU_FREQ_GOV_BADASS
	depends on CPU_FREQ_GOV_BADASS_2_PHASE
	help
	  '3-phase' - This driver adds a new algo to save power

config CPU_FREQ_GOV_BADASS_3_PHASE_FREQ
	int "'3-phase' badass frequency"
	default 1188000
	depends on CPU_FREQ_GOV_BADASS
	depends on CPU_FREQ_GOV_BADASS_2_PHASE
	depends on CPU_FREQ_GOV_BADASS_3_PHASE

config CPU_FREQ_GOV_SAVAGEDZEN

	tristate "'savagedzen' cpufreq governor"
	depends on CPU_FREQ
	help
	  'Savaged-Zen' - a smartass based governor

	  If in doubt, say N.

config CPU_FREQ_GOV_LULZACTIVE
	tristate "'lulzactive' cpufreq governor"
	depends on CPU_FREQ
	help
	   'lulzactive' - a new interactive governor by Tegrak!

config CPU_FREQ_GOV_HYPER
        tristate "'HYPER' cpufreq governor"
        depends on CPU_FREQ
        ---help---
        'HYPER' - a tweaked "ondemand" based smart and optimized
         governor!

         If in doubt, say Y.

config CPU_FREQ_GOV_SMARTASS
        tristate "'smartass' cpufreq governor"
        depends on CPU_FREQ
        ---help---
'smartass' - a "smart" optimized governor for the hero!

config CPU_FREQ_GOV_ZENX
        tristate "'zenx' cpufreq governor"
        depends on CPU_FREQ
        help
        'zenx' - an interactive-based governor
        This governor provides full CPU hotplugging support
        based on average CPU load across all CPUs.

        For details, take a look at linux/Documentation/cpu-freq.

        If in doubt, say N
endif	# CPU_FREQ
```
